## manifest/west.yml
```yaml
manifest:
  version: 0.8

  projects:
    - name: tool-ec
      url: https://github.com/bluccino/tool-ec.git
      path: deps/tool-ec

    - name: tool-idb
      url: https://github.com/bluccino/tool-idb.git
      path: deps/tool-idb
```
